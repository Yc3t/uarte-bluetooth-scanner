/ {
    chosen {
        zephyr,console = &uart0;
        zephyr,shell-uart = &uart0;
    };
};

&uart0 {
    status = "okay";
    current-speed = <115200>;
    hw-flow-control;

    tx-pin = <6>;    // P0.6
    rx-pin = <8>;    // P0.8
    
    dmas = <&pdma 0>;
    dma-names = "tx";
};

/ {
    pdma: pdma@41004000 {
        compatible = "nordic,nrf-pdma";
        reg = <0x41004000 0x1000>;
        interrupts = <4 NRF_DEFAULT_IRQ_PRIORITY>;
        status = "okay";
        #dma-cells = <1>;
    };
};